#include "ssd1306.h"
#include "driver/i2c.h"
#include "freertos/FreeRTOS.h"
#include "freertos/task.h"
#include <string.h>
#include <stdio.h>

// Use the I2C port that your application has configured (here, I2C_NUM_0).
#define I2C_MASTER_NUM      I2C_NUM_0

// The display buffer – one bit per pixel.
static uint8_t ssd1306_buffer[SSD1306_BUFFER_SIZE] = {0};

/******************************************************
 * 5x7 font table for ASCII characters 0x20–0x7F.
 * Each character is 5 bytes wide.
 ******************************************************/
static const uint8_t font5x7[96][5] = {
    {0x00,0x00,0x00,0x00,0x00}, // ' '
    {0x00,0x00,0x5F,0x00,0x00}, // '!'
    {0x00,0x07,0x00,0x07,0x00}, // '"'
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    {0x10,0x08,0x08,0x10,0x08}  // '~'
};

/******************************************************
 * Helper function to send a single command byte.
 ******************************************************/
static esp_err_t ssd1306_send_command(uint8_t cmd)
{
    i2c_cmd_handle_t cmd_handle = i2c_cmd_link_create();
    esp_err_t ret;
    i2c_master_start(cmd_handle);
    i2c_master_write_byte(cmd_handle, (SSD1306_I2C_ADDR << 1) | I2C_MASTER_WRITE, true);
    i2c_master_write_byte(cmd_handle, 0x00, true); // Control byte: Co = 0, D/C# = 0 (command)
    i2c_master_write_byte(cmd_handle, cmd, true);
    i2c_master_stop(cmd_handle);
    ret = i2c_master_cmd_begin(I2C_MASTER_NUM, cmd_handle, pdMS_TO_TICKS(1000));
    i2c_cmd_link_delete(cmd_handle);
    return ret;
}

/******************************************************
 * ssd1306_init
 * Sends the standard initialization sequence to the SSD1306.
 ******************************************************/
esp_err_t ssd1306_init(void)
{
    // Wait a moment after power-up.
    vTaskDelay(pdMS_TO_TICKS(100));

    ssd1306_send_command(0xAE); // Display off
    ssd1306_send_command(0xD5); // Set display clock divide ratio/oscillator frequency
    ssd1306_send_command(0x80); // Suggested ratio
    ssd1306_send_command(0xA8); // Set multiplex ratio (1 to 64)
    ssd1306_send_command(0x3F); // 64MUX
    ssd1306_send_command(0xD3); // Set display offset
    ssd1306_send_command(0x00); // No offset
    ssd1306_send_command(0x40 | 0x00); // Set start line address at 0
    ssd1306_send_command(0x8D); // Charge pump setting
    ssd1306_send_command(0x14); // Enable charge pump
    ssd1306_send_command(0x20); // Memory addressing mode
    ssd1306_send_command(0x00); // Horizontal addressing mode
    ssd1306_send_command(0xA1); // Set segment re-map
    ssd1306_send_command(0xC8); // COM output scan direction remapped
    ssd1306_send_command(0xDA); // Set COM pins hardware configuration
    ssd1306_send_command(0x12);
    ssd1306_send_command(0x81); // Contrast control
    ssd1306_send_command(0xCF);
    ssd1306_send_command(0xD9); // Pre-charge period
    ssd1306_send_command(0xF1);
    ssd1306_send_command(0xDB); // VCOMH deselect level
    ssd1306_send_command(0x40);
    ssd1306_send_command(0xA4); // Entire display ON (resume RAM content)
    ssd1306_send_command(0xA6); // Normal display (not inverted)
    ssd1306_send_command(0xAF); // Display ON

    ssd1306_clear_screen();
    ssd1306_update_screen();
    return ESP_OK;
}

/******************************************************
 * ssd1306_clear_screen
 * Clears the internal display buffer.
 ******************************************************/
void ssd1306_clear_screen(void)
{
    memset(ssd1306_buffer, 0, sizeof(ssd1306_buffer));
}

/******************************************************
 * ssd1306_update_screen
 * Sends the entire display buffer to the SSD1306.
 ******************************************************/
esp_err_t ssd1306_update_screen(void)
{
    esp_err_t ret;
    // Set column and page addressing to update the entire screen.
    ssd1306_send_command(0x21); // Set column address command
    ssd1306_send_command(0);    // Start column = 0
    ssd1306_send_command(SSD1306_WIDTH - 1); // End column

    ssd1306_send_command(0x22); // Set page address command
    ssd1306_send_command(0);    // Start page = 0
    ssd1306_send_command((SSD1306_HEIGHT / 8) - 1); // End page

    // Write buffer data in one transaction.
    i2c_cmd_handle_t cmd_handle = i2c_cmd_link_create();
    i2c_master_start(cmd_handle);
    i2c_master_write_byte(cmd_handle, (SSD1306_I2C_ADDR << 1) | I2C_MASTER_WRITE, true);
    i2c_master_write_byte(cmd_handle, 0x40, true); // Control byte: Co = 0, D/C# = 1 (data)
    i2c_master_write(cmd_handle, ssd1306_buffer, SSD1306_BUFFER_SIZE, true);
    i2c_master_stop(cmd_handle);
    ret = i2c_master_cmd_begin(I2C_MASTER_NUM, cmd_handle, pdMS_TO_TICKS(1000));
    i2c_cmd_link_delete(cmd_handle);
    return ret;
}

/******************************************************
 * ssd1306_display_text
 * Renders a null-terminated text string into the internal buffer at a given row.
 *
 * The font is fixed at 5 pixels wide per character with 1 pixel spacing.
 * The text is rendered on a page (8 pixels tall).
 ******************************************************/
void ssd1306_display_text(const char* text, uint8_t row)
{
    // Make sure the row is valid (each page is 8 pixels tall)
    if (row >= (SSD1306_HEIGHT / 8))
        return;

    uint16_t x = 0;
    while (*text && (x + 6 <= SSD1306_WIDTH)) {
        char c = *text++;
        if (c < 32 || c > 127)
            c = '?'; // Replace unsupported characters

        uint8_t index = c - 32;
        // Copy the 5-byte font for the character.
        for (int i = 0; i < 5; i++) {
            ssd1306_buffer[row * SSD1306_WIDTH + x++] = font5x7[index][i];
        }
        // One pixel column as spacing.
        ssd1306_buffer[row * SSD1306_WIDTH + x++] = 0x00;
    }
}
